/dts-v1/;
/plugin/;

/*
 * Suspend diagnosis only. Keep the existing 4 MiB reservation unchanged.
 * EDK2 writes its log to the first 2 MiB. Move the Linux console to the
 * second 2 MiB so the following firmware boot cannot overwrite PM callbacks.
 * Linux crash-record slots occupy the first half; pmsg is disabled here.
 */
/ {
	fragment@0 {
		target-path = "/reserved-memory/ramoops-region";
		__overlay__ {
			console-size = <0x200000>;
			record-size = <0x40000>;
			pmsg-size = <0>;
		};
	};
};
